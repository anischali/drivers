## Kconfig
```kconfig
# SPDX-License-Identifier: GPL-2.0-or-later
menu "HID Composite support"
    depends on USB_HID

config USB_HID_COMPOSITE
    bool "USB HID Composite group"
    depends on USB_HID
    default n
    select MFD_CORE
    help
        The usb HID Composite is driver that adds an interface subclass to
        the HID interface class to be able to use multiple HID usage pages
        and have multiple drivers in multi function device manner.


config USB_HID_COMPOSITE_DEBUG
	bool "Debug symbols for hid-composite"
	depends on USB_HID_COMPOSITE && DEBUG_INFO
	help
        Activate the debug informations for HID Composite.


config USB_HID_COMPOSITE_POWER_SUPPLY
    bool "USB HID Composite power supply"
    depends on USB_HID_COMPOSITE && POWER_SUPPLY
    help
        The usb HID Composite power supply is driver that exposes system battery
        page to the system and it implements several usages to present a battery
        or a charger or both.


config USB_HID_COMPOSITE_TYPEC
    bool "USB HID Composite usb typec"
    depends on USB_HID_COMPOSITE && USB_ROLE_SWITCH
    help
        The usb HID Composite usb typec is a driver that exposes an usb typec 
        page to the system and it implements several usages to present a typec 
        common operation (power dilevery/data roles).

config USB_HID_COMPOSITE_RTC
    bool "USB HID Composite RTC"
    depends on USB_HID_COMPOSITE && RTC_CLASS
    help
        The usb HID Composite rtc is driver that exposes time sensor page
        to the system and it implements an RTC time with alarm feature.

config USB_HID_COMPOSITE_GPIO
    bool "USB HID Composite GPIO"
    depends on USB_HID_COMPOSITE && RTC_CLASS
    help
        The usb HID Composite gpio is driver that exposes an io expander
        to the system and it implements an GPIO expander features.

config USB_HID_COMPOSITE_RGB_LEDS
    bool "USB HID Composite RGB LEDS"
    depends on USB_HID_COMPOSITE && LEDS_CLASS
    help
        The usb HID Composite RGB LEDS is driver that exposes an rgb led
        to the system.

endmenu
```

## hid-composite/Kconfig
```kconfig
# SPDX-License-Identifier: GPL-2.0-or-later
menu "HID Composite support"
    depends on USB_HID

config USB_HID_COMPOSITE
    bool "USB HID Composite group"
    depends on USB_HID && MFD_CORE
    default n
    help
        The usb HID Composite is driver that adds an interface subclass to
        the HID interface class to be able to use multiple HID usage pages
        and have multiple drivers in multi function device manner.


config USB_HID_COMPOSITE_DEBUG
	bool "Debug symbols for hid-composite"
	depends on USB_HID_COMPOSITE && DEBUG_INFO
	help
        Activate the debug informations for HID Composite.


config USB_HID_COMPOSITE_BATTERY
    bool "USB HID Composite battery"
    depends on USB_HID_COMPOSITE && POWER_SUPPLY
    help
        The usb HID Composite battery is driver that exposes system battery
        page to the system and it implements several usages to present a battery
        or a charger or both.


config USB_HID_COMPOSITE_RTC
    bool "USB HID Composite RTC"
    depends on USB_HID_COMPOSITE && RTC_CLASS
    help
        The usb HID Composite rtc is driver that exposes time sensor page
        to the system and it implements an RTC time with alarm feature.


config USB_HID_COMPOSITE_RGB_LEDS
    bool "USB HID Composite RGB LEDS"
    depends on USB_HID_COMPOSITE && LEDS_CLASS
    help
        The usb HID Composite RGB LEDS is driver that exposes an rgb led
        to the system.

endmenu
```
